## CMakeLists.txt
```
cmake_minimum_required(VERSION 3.20.0)
find_package(Zephyr REQUIRED HINTS $ENV{ZEPHYR_BASE})
project(simple-web-zephyr)

FILE(GLOB app_sources src/*.c)
target_sources(app PRIVATE ${app_sources})
```

## Kconfig
```
mainmenu "WebUSB Broadcast Assistant"

config TX_MSG_MAX_MESSAGES
	int "The maximum number of elements in the transmit pipeline"
	default 4

config TX_MSG_MAX_PAYLOAD_LEN
	int "The maximum payload size of a message in the transmit pipeline"
	default 1024

source "Kconfig.zephyr"
```

## prj.conf
```kconfig
# Bluetooth & Settings
CONFIG_BT=y
CONFIG_BT_CENTRAL=y
CONFIG_BT_AUDIO=y
CONFIG_BT_SMP=y
CONFIG_BT_BONDABLE=y
CONFIG_BT_BUF_ACL_RX_SIZE=255
CONFIG_BT_BUF_ACL_TX_SIZE=251
CONFIG_BT_CTLR_SCAN_DATA_LEN_MAX=191
CONFIG_BT_TINYCRYPT_ECC=y
CONFIG_BT_EXT_ADV=y
CONFIG_BT_BAP_BROADCAST_ASSISTANT=y
CONFIG_BT_BAP_BASS_MAX_SUBGROUPS=5
CONFIG_BT_VCP_VOL_CTLR=y
CONFIG_BT_CSIP_SET_COORDINATOR=y
CONFIG_BT_ATT_TX_COUNT=12

# The following seemed necessary for a successful
# connection flow on some devices.
# TODO: Investigate if some can be removed.
CONFIG_BT_PRIVACY=y
CONFIG_BT_SIGNING=y
CONFIG_BT_REMOTE_INFO=y
CONFIG_BT_REMOTE_VERSION=y
CONFIG_BT_MAX_CONN=3
CONFIG_BT_MAX_PAIRED=3
CONFIG_BT_FIXED_PASSKEY=y


# USB Device Settings
CONFIG_USB_DEVICE_STACK=y
CONFIG_USB_DEVICE_BOS=y
# CONFIG_SERIAL=y
CONFIG_USB_DEVICE_PRODUCT="WebUSB Broadcast Assistant"
CONFIG_USB_DEVICE_PID=0x000A
# CONFIG_UART_INTERRUPT_DRIVEN=y
# CONFIG_UART_LINE_CTRL=y
CONFIG_USB_DEVICE_INITIALIZE_AT_BOOT=n
CONFIG_RING_BUFFER=y
CONFIG_PRINTK=y

# Shell & Logging

CONFIG_LOG=y
# CONFIG_USB_DRIVER_LOG_LEVEL_ERR=y

CONFIG_BT_RX_STACK_SIZE=4096
CONFIG_SYSTEM_WORKQUEUE_STACK_SIZE=4096

CONFIG_BT_CSIP_SET_COORDINATOR_LOG_LEVEL_DBG=n
CONFIG_BT_BAP_BROADCAST_ASSISTANT_LOG_LEVEL_INF=y
CONFIG_BT_BAP_SCAN_DELEGATOR_LOG_LEVEL_INF=y
CONFIG_BT_SMP_LOG_LEVEL_DBG=n
CONFIG_BT_CONN_LOG_LEVEL_DBG=n
CONFIG_BT_AUDIO_CODEC_CFG_MAX_METADATA_SIZE=64
CONFIG_BT_AUDIO_CODEC_CFG_MAX_DATA_SIZE=64
CONFIG_BT_AUDIO_CODEC_CAP_MAX_METADATA_SIZE=64
CONFIG_BT_AUDIO_CODEC_CAP_MAX_DATA_SIZE=64

CONFIG_BT_EXT_ADV=y
CONFIG_BT_PER_ADV=y
CONFIG_BT_PER_ADV_SYNC=y
CONFIG_BT_PER_ADV_SYNC_MAX=2
CONFIG_BT_PER_ADV_SYNC_TRANSFER_SENDER=y
CONFIG_BT_PER_ADV_SYNC_TRANSFER_RECEIVER=y
```

## boards/nrf52840dongle_nrf52840.conf
```kconfig
# Workaround for peer peripherals sending long ACL Data PDUs
# before completing data length update procedure
CONFIG_BT_ISO_CENTRAL=y
CONFIG_BT_PERIPHERAL=y
CONFIG_BT_ISO_PERIPHERAL=y

# Enable Periodic Advertising Sync Transfer - Send/Recv
CONFIG_BT_PER_ADV_SYNC_TRANSFER_SENDER=y
CONFIG_BT_CTLR_SYNC_TRANSFER_SENDER=y
```

## src/main.c
```c
/*
 * Copyright (c) 2024 Demant A/S
 *
 * SPDX-License-Identifier: Apache-2.0
 */

/**
 * @file
 * @brief Sample app for a WebUSB Broadcast Assistant
 */

#include <zephyr/usb/usb_device.h>

#include "webusb.h"
#include "msosv2.h"
#include "broadcast_assistant.h"
#include "heartbeat.h"
#include "message.h"

LOG_MODULE_REGISTER(main, LOG_LEVEL_INF);

int main(void)
{
	int ret;

	LOG_INF("web-broadcast-assistants starting");

	/* Initialize WebUSB component */
	msosv2_init();
	webusb_init();

	/* Set the message handler */
	webusb_register_message_handler(&message_handler);

	heartbeat_init();

	ret = usb_enable(NULL);
	if (ret != 0) {
		LOG_ERR("Failed to enable USB");
		return ret;
	}

	/* Bluetooth initialization */
	ret = broadcast_assistant_init();
	if (ret != 0) {
		LOG_ERR("Failed to initialise broadcast assistant");
		return ret;
	}

	return 0;
}
```

## src/broadcast_assistant.h
```c
/*
 * Copyright (c) 2024 Demant A/S
 *
 * SPDX-License-Identifier: Apache-2.0
 */

#ifndef __BROADCAST_ASSISTANT_H__
#define __BROADCAST_ASSISTANT_H__

#include <zephyr/types.h>
#include <zephyr/bluetooth/gap.h>
#include <zephyr/bluetooth/addr.h>
#include <zephyr/bluetooth/audio/audio.h>
#include <zephyr/bluetooth/audio/csip.h>

#define BT_DATA_RSSI            (BT_DATA_MANUFACTURER_DATA - 1)
#define BT_DATA_SID             (BT_DATA_MANUFACTURER_DATA - 2)
#define BT_DATA_PA_INTERVAL     (BT_DATA_MANUFACTURER_DATA - 3)
#define BT_DATA_ERROR_CODE      (BT_DATA_MANUFACTURER_DATA - 4)
#define BT_DATA_BROADCAST_ID    (BT_DATA_MANUFACTURER_DATA - 5)
#define BT_DATA_RPA             (BT_DATA_MANUFACTURER_DATA - 6)
#define BT_DATA_IDENTITY        (BT_DATA_MANUFACTURER_DATA - 7)
#define BT_DATA_BASE            (BT_DATA_MANUFACTURER_DATA - 8)
#define BT_DATA_SOURCE_ID       (BT_DATA_MANUFACTURER_DATA - 9)
#define BT_DATA_BIS_SYNC        (BT_DATA_MANUFACTURER_DATA - 10)
#define BT_DATA_VOLUME          (BT_DATA_MANUFACTURER_DATA - 11)
#define BT_DATA_MUTE            (BT_DATA_MANUFACTURER_DATA - 12)
#define BT_DATA_SIRK            (BT_DATA_MANUFACTURER_DATA - 13)
#define BT_DATA_SET_SIZE        (BT_DATA_MANUFACTURER_DATA - 14)
#define BT_DATA_SET_RANK        (BT_DATA_MANUFACTURER_DATA - 15)
#define BT_DATA_PA_SYNC_ATTEMPT (BT_DATA_MANUFACTURER_DATA - 16)

enum {
	BROADCAST_ASSISTANT_SCAN_IDLE = 0,
	BROADCAST_ASSISTANT_SCAN_SOURCE = BIT(0),
	BROADCAST_ASSISTANT_SCAN_SINK = BIT(1),
	BROADCAST_ASSISTANT_SCAN_CSIS = BIT(2),
};

int broadcast_assistant_start_scan(uint8_t mode, uint8_t set_size, uint8_t sirk[BT_CSIP_SIRK_SIZE],
				   uint8_t pa_sync_attempt);
int broadcast_assistant_stop_scanning(void);
int broadcast_assistant_disconnect_unpair_all(void);
int broadcast_assistant_connect_to_sink(bt_addr_le_t *bt_addr_le);
int broadcast_assistant_disconnect_from_sink(bt_addr_le_t *bt_addr_le);
int broadcast_assistant_add_source(uint8_t sid, uint16_t pa_interval, uint32_t broadcast_id,
				   bt_addr_le_t *addr, uint8_t num_subgroups, uint32_t *bis_sync);
int broadcast_assistant_pa_sync(bt_addr_le_t *addr, uint8_t sid, uint16_t interval);
int broadcast_assistant_remove_source(uint8_t source_id, uint8_t num_subgroups);
int broadcast_assistant_add_broadcast_code(
	uint8_t src_id, const uint8_t broadcast_code[BT_ISO_BROADCAST_CODE_SIZE]);
int broadcast_assistant_set_volume(bt_addr_le_t *bt_addr_le, uint8_t volume);
int broadcast_assistant_set_mute(bt_addr_le_t *bt_addr_le, uint8_t state);
int broadcast_assistant_reset(void);
int broadcast_assistant_init(void);

#endif /* __BROADCAST_ASSISTANT_H__ */
```

## src/cobs.c
```c
/* ----------------------------------------------------------------------------
 * Copyright (c) 2010 Craig McQueen
 *
 * Permission is hereby granted, free of charge, to any person obtaining a copy
 * of this software and associated documentation files (the "Software"), to deal
 * in the Software without restriction, including without limitation the rights
 * to use, copy, modify, merge, publish, distribute, sublicense, and/or sell
 * copies of the Software, and to permit persons to whom the Software is
 * furnished to do so, subject to the following conditions:
 *
 * The above copyright notice and this permission notice shall be included in
 * all copies or substantial portions of the Software.
 *
 * THE SOFTWARE IS PROVIDED "AS IS", WITHOUT WARRANTY OF ANY KIND, EXPRESS OR
 * IMPLIED, INCLUDING BUT NOT LIMITED TO THE WARRANTIES OF MERCHANTABILITY,
 * FITNESS FOR A PARTICULAR PURPOSE AND NONINFRINGEMENT. IN NO EVENT SHALL THE
 * AUTHORS OR COPYRIGHT HOLDERS BE LIABLE FOR ANY CLAIM, DAMAGES OR OTHER
 * LIABILITY, WHETHER IN AN ACTION OF CONTRACT, TORT OR OTHERWISE, ARISING FROM,
 * OUT OF OR IN CONNECTION WITH THE SOFTWARE OR THE USE OR OTHER DEALINGS IN THE
 * SOFTWARE.
 * ----------------------------------------------------------------------------
 *
 * cobs.c
 *
 * Consistent Overhead Byte Stuffing
 *
 */

#include <stdlib.h>
#include "cobs.h"


/*****************************************************************************
 * Defines
 ****************************************************************************/

#ifndef FALSE
#define FALSE       (0)
#endif

#ifndef TRUE
#define TRUE        (!FALSE)
#endif


/*****************************************************************************
 * Functions
 ****************************************************************************/

/* COBS-encode a string of input bytes.
 *
 * dst_buf_ptr:    The buffer into which the result will be written
 * dst_buf_len:    Length of the buffer into which the result will be written
 * src_ptr:        The byte string to be encoded
 * src_len         Length of the byte string to be encoded
 *
 * returns:        A struct containing the success status of the encoding
 *                 operation and the length of the result (that was written to
 *                 dst_buf_ptr)
 */
cobs_encode_result cobs_encode(void * dst_buf_ptr, size_t dst_buf_len,
                               const void * src_ptr, size_t src_len)
{
    cobs_encode_result  result              = { 0, COBS_ENCODE_OK };
    const uint8_t *     src_read_ptr        = src_ptr;
    const uint8_t *     src_end_ptr         = (uint8_t*) src_ptr + src_len;
    uint8_t *           dst_buf_start_ptr   = dst_buf_ptr;
    uint8_t *           dst_buf_end_ptr     = (uint8_t*) dst_buf_ptr + dst_buf_len;
    uint8_t *           dst_code_write_ptr  = dst_buf_ptr;
    uint8_t *           dst_write_ptr       = dst_code_write_ptr + 1;
    uint8_t             src_byte            = 0;
    uint8_t             search_len          = 1;


    /* First, do a NULL pointer check and return immediately if it fails. */
    if ((dst_buf_ptr == NULL) || (src_ptr == NULL))
    {
        result.status = COBS_ENCODE_NULL_POINTER;
        return result;
    }

    if (src_len != 0)
    {
        /* Iterate over the source bytes */
        for (;;)
        {
            /* Check for running out of output buffer space */
            if (dst_write_ptr >= dst_buf_end_ptr)
            {
                result.status |= COBS_ENCODE_OUT_BUFFER_OVERFLOW;
                break;
            }

            src_byte = *src_read_ptr++;
            if (src_byte == 0)
            {
                /* We found a zero byte */
                *dst_code_write_ptr = search_len;
                dst_code_write_ptr = dst_write_ptr++;
                search_len = 1;
                if (src_read_ptr >= src_end_ptr)
                {
                    break;
                }
            }
            else
            {
                /* Copy the non-zero byte to the destination buffer */
                *dst_write_ptr++ = src_byte;
                search_len++;
                if (src_read_ptr >= src_end_ptr)
                {
                    break;
                }
                if (search_len == 0xFF)
                {
                    /* We have a long string of non-zero bytes, so we need
                     * to write out a length code of 0xFF. */
                    *dst_code_write_ptr = search_len;
                    dst_code_write_ptr = dst_write_ptr++;
                    search_len = 1;
                }
            }
        }
    }

    /* We've reached the end of the source data (or possibly run out of output buffer)
     * Finalise the remaining output. In particular, write the code (length) byte.
     * Update the pointer to calculate the final output length.
     */
    if (dst_code_write_ptr >= dst_buf_end_ptr)
    {
        /* We've run out of output buffer to write the code byte. */
        result.status |= COBS_ENCODE_OUT_BUFFER_OVERFLOW;
        dst_write_ptr = dst_buf_end_ptr;
    }
    else
    {
        /* Write the last code (length) byte. */
        *dst_code_write_ptr = search_len;
    }

    /* Calculate the output length, from the value of dst_code_write_ptr */
    result.out_len = dst_write_ptr - dst_buf_start_ptr;

    return result;
}


/* Decode a COBS byte string.
 *
 * dst_buf_ptr:    The buffer into which the result will be written
 * dst_buf_len:    Length of the buffer into which the result will be written
 * src_ptr:        The byte string to be decoded
 * src_len         Length of the byte string to be decoded
 *
 * returns:        A struct containing the success status of the decoding
 *                 operation and the length of the result (that was written to
 *                 dst_buf_ptr)
 */
cobs_decode_result cobs_decode(void * dst_buf_ptr, size_t dst_buf_len,
                               const void * src_ptr, size_t src_len)
{
    cobs_decode_result  result              = { 0, COBS_DECODE_OK };
    const uint8_t *     src_read_ptr        = src_ptr;
    const uint8_t *     src_end_ptr         = (uint8_t*) src_ptr + src_len;
    uint8_t *           dst_buf_start_ptr   = dst_buf_ptr;
    uint8_t *           dst_buf_end_ptr     = (uint8_t*) dst_buf_ptr + dst_buf_len;
    uint8_t *           dst_write_ptr       = dst_buf_ptr;
    size_t              remaining_bytes;
    uint8_t             src_byte;
    uint8_t             i;
    uint8_t             len_code;

    /* First, do a NULL pointer check and return immediately if it fails. */
    if ((dst_buf_ptr == NULL) || (src_ptr == NULL))
    {
        result.status = COBS_DECODE_NULL_POINTER;
        return result;
    }

    if (src_len != 0)
    {
        for (;;)
        {
            len_code = *src_read_ptr++;
            if (len_code == 0)
            {
                result.status |= COBS_DECODE_ZERO_BYTE_IN_INPUT;
                break;
            }
            len_code--;

            /* Check length code against remaining input bytes */
            remaining_bytes = src_end_ptr - src_read_ptr;
            if (len_code > remaining_bytes)
            {
                result.status |= COBS_DECODE_INPUT_TOO_SHORT;
                len_code = remaining_bytes;
            }

            /* Check length code against remaining output buffer space */
            remaining_bytes = dst_buf_end_ptr - dst_write_ptr;
            if (len_code > remaining_bytes)
            {
                result.status |= COBS_DECODE_OUT_BUFFER_OVERFLOW;
                len_code = remaining_bytes;
            }

            for (i = len_code; i != 0; i--)
            {
                src_byte = *src_read_ptr++;
                if (src_byte == 0)
                {
                    result.status |= COBS_DECODE_ZERO_BYTE_IN_INPUT;
                }
                *dst_write_ptr++ = src_byte;
            }

            if (src_read_ptr >= src_end_ptr)
            {
                break;
            }

            /* Add a zero to the end */
            if (len_code != 0xFE)
            {
                if (dst_write_ptr >= dst_buf_end_ptr)
                {
                    result.status |= COBS_DECODE_OUT_BUFFER_OVERFLOW;
                    break;
                }
                *dst_write_ptr++ = 0;
            }
        }
    }

    result.out_len = dst_write_ptr - dst_buf_start_ptr;

    return result;
}
```

## src/cobs.h
```c
/* ----------------------------------------------------------------------------
 * Copyright (c) 2010 Craig McQueen
 *
 * Permission is hereby granted, free of charge, to any person obtaining a copy
 * of this software and associated documentation files (the "Software"), to deal
 * in the Software without restriction, including without limitation the rights
 * to use, copy, modify, merge, publish, distribute, sublicense, and/or sell
 * copies of the Software, and to permit persons to whom the Software is
 * furnished to do so, subject to the following conditions:
 *
 * The above copyright notice and this permission notice shall be included in
 * all copies or substantial portions of the Software.
 *
 * THE SOFTWARE IS PROVIDED "AS IS", WITHOUT WARRANTY OF ANY KIND, EXPRESS OR
 * IMPLIED, INCLUDING BUT NOT LIMITED TO THE WARRANTIES OF MERCHANTABILITY,
 * FITNESS FOR A PARTICULAR PURPOSE AND NONINFRINGEMENT. IN NO EVENT SHALL THE
 * AUTHORS OR COPYRIGHT HOLDERS BE LIABLE FOR ANY CLAIM, DAMAGES OR OTHER
 * LIABILITY, WHETHER IN AN ACTION OF CONTRACT, TORT OR OTHERWISE, ARISING FROM,
 * OUT OF OR IN CONNECTION WITH THE SOFTWARE OR THE USE OR OTHER DEALINGS IN THE
 * SOFTWARE.
 * ----------------------------------------------------------------------------
 *
 * cobs.h
 *
 * Consistent Overhead Byte Stuffing
 *
 */

#ifndef COBS_H_
#define COBS_H_


/*****************************************************************************
 * Includes
 ****************************************************************************/

#include <stdint.h>
#include <stdlib.h>


/*****************************************************************************
 * Defines
 ****************************************************************************/

#define COBS_ENCODE_DST_BUF_LEN_MAX(SRC_LEN)            ((SRC_LEN) + (((SRC_LEN) + 253u)/254u))
#define COBS_DECODE_DST_BUF_LEN_MAX(SRC_LEN)            (((SRC_LEN) == 0) ? 0u : ((SRC_LEN) - 1u))

/*
 * For in-place encoding, the source data must be offset in the buffer by
 * the following amount (or more).
 */
#define COBS_ENCODE_SRC_OFFSET(SRC_LEN)                 (((SRC_LEN) + 253u)/254u)


/*****************************************************************************
 * Typedefs
 ****************************************************************************/

typedef enum
{
    COBS_ENCODE_OK                  = 0x00,
    COBS_ENCODE_NULL_POINTER        = 0x01,
    COBS_ENCODE_OUT_BUFFER_OVERFLOW = 0x02
} cobs_encode_status;

typedef struct
{
    size_t              out_len;
    cobs_encode_status  status;
} cobs_encode_result;


typedef enum
{
    COBS_DECODE_OK                  = 0x00,
    COBS_DECODE_NULL_POINTER        = 0x01,
    COBS_DECODE_OUT_BUFFER_OVERFLOW = 0x02,
    COBS_DECODE_ZERO_BYTE_IN_INPUT  = 0x04,
    COBS_DECODE_INPUT_TOO_SHORT     = 0x08
} cobs_decode_status;

typedef struct
{
    size_t              out_len;
    cobs_decode_status  status;
} cobs_decode_result;


/*****************************************************************************
 * Function prototypes
 ****************************************************************************/

#ifdef __cplusplus
extern "C" {
#endif

/* COBS-encode a string of input bytes.
 *
 * dst_buf_ptr:    The buffer into which the result will be written
 * dst_buf_len:    Length of the buffer into which the result will be written
 * src_ptr:        The byte string to be encoded
 * src_len         Length of the byte string to be encoded
 *
 * returns:        A struct containing the success status of the encoding
 *                 operation and the length of the result (that was written to
 *                 dst_buf_ptr)
 */
cobs_encode_result cobs_encode(void * dst_buf_ptr, size_t dst_buf_len,
                               const void * src_ptr, size_t src_len);

/* Decode a COBS byte string.
 *
 * dst_buf_ptr:    The buffer into which the result will be written
 * dst_buf_len:    Length of the buffer into which the result will be written
 * src_ptr:        The byte string to be decoded
 * src_len         Length of the byte string to be decoded
 *
 * returns:        A struct containing the success status of the decoding
 *                 operation and the length of the result (that was written to
 *                 dst_buf_ptr)
 */
cobs_decode_result cobs_decode(void * dst_buf_ptr, size_t dst_buf_len,
                               const void * src_ptr, size_t src_len);

#ifdef __cplusplus
} /* extern "C" */
#endif


#endif /* COBS_H_ */
```

## src/heartbeat.c
```c
/*
 * Copyright (c) 2024 Demant A/S
 *
 * SPDX-License-Identifier: Apache-2.0
 */

#include <zephyr/types.h>
#include <zephyr/logging/log.h>
#include <zephyr/net_buf.h>

#include "message.h"

static bool heartbeat_on;
static uint8_t heartbeat_cnt;

static void heartbeat_timeout_handler(struct k_timer *dummy_p);
K_TIMER_DEFINE(heartbeat_timer, heartbeat_timeout_handler, NULL);

static void heartbeat_timeout_handler(struct k_timer *timer)
{
	message_send_no_paylod(MESSAGE_TYPE_EVT, MESSAGE_SUBTYPE_HEARTBEAT, heartbeat_cnt++);
}

void heartbeat_start(void)
{
	if (!heartbeat_on) {
		// Start generating heartbeats every second
		heartbeat_on = true;
		k_timer_start(&heartbeat_timer, K_SECONDS(1), K_SECONDS(1));
	}
}

void heartbeat_stop(void)
{
	if (heartbeat_on) {
		heartbeat_on = false;
		k_timer_stop(&heartbeat_timer);
	}
}

void heartbeat_toggle(void)
{
	if (!heartbeat_on) {
		heartbeat_start();
	} else {
		heartbeat_stop();
	}
}

void heartbeat_init(void)
{
	heartbeat_on = false;
	k_timer_init(&heartbeat_timer, heartbeat_timeout_handler, NULL);
}
```

## src/heartbeat.h
```c
/*
 * Copyright (c) 2024 Demant A/S
 *
 * SPDX-License-Identifier: Apache-2.0
 */

#ifndef __HEARTBEAT_H__
#define __HEARTBEAT_H__

#include <zephyr/types.h>

void heartbeat_start(void);
void heartbeat_stop(void);
void heartbeat_toggle(void);
void heartbeat_init(void);

#endif /* __HEARTBEAT_H__ */
```

## src/message.c
```c
/*
 * Copyright (c) 2024 Demant A/S
 *
 * SPDX-License-Identifier: Apache-2.0
 */

#include <zephyr/types.h>
#include <zephyr/logging/log.h>
#include <zephyr/kernel.h>
#include <zephyr/sys/byteorder.h>
#include <zephyr/net_buf.h>
#include <zephyr/bluetooth/bluetooth.h>
#include <zephyr/bluetooth/audio/bap.h>
#include <zephyr/bluetooth/audio/vcp.h>

#include "webusb.h"
#include "broadcast_assistant.h"
#include "heartbeat.h"
#include "message.h"

LOG_MODULE_REGISTER(message_handler, LOG_LEVEL_INF);

NET_BUF_POOL_DEFINE(command_tx_msg_pool, CONFIG_TX_MSG_MAX_MESSAGES,
		    sizeof(struct webusb_message) + CONFIG_TX_MSG_MAX_PAYLOAD_LEN, 0, NULL);

#define DEFAULT_PA_SYNC_ATTEMPT 10

struct webusb_ltv_data {
	uint8_t adv_sid;
	uint16_t pa_interval;
	uint32_t broadcast_id;
	bt_addr_le_t addr;
	uint8_t src_id;
	uint8_t volume;
	uint8_t broadcast_code[BT_ISO_BROADCAST_CODE_SIZE];
	uint8_t num_subgroups;
	uint32_t bis_sync[CONFIG_BT_BAP_BASS_MAX_SUBGROUPS];
	uint8_t csis_set_size;
	uint8_t csis_sirk[BT_CSIP_SIRK_SIZE];
	uint8_t pa_sync_attempt;
};

static struct webusb_ltv_data parsed_ltv_data;

static void message_log_ltv(uint8_t *data, uint16_t data_len);
static void message_prepend_header(struct net_buf *buf, enum message_type mtype,
				   enum message_sub_type stype, uint8_t seq_no, uint16_t len);

#define LTV_STR_LEN 1024

static void message_log_ltv(uint8_t *data, uint16_t data_len)
{
	char ltv_str[LTV_STR_LEN] = {0};

	/* Log message payload (ltv format) */
	for (int i = 0; i < data_len;) {
		uint8_t ltv_len = *data++;
		char *ch_ptr = &ltv_str[0];

		/* length */
		sprintf(ch_ptr, "[ L:%02x ", ltv_len);
		ch_ptr += 7;
		if (ltv_len > 0) {
			/* type */
			sprintf(ch_ptr, "T:%02x ", *data++);
			ch_ptr += 5;
			if (ltv_len > 1) {
				/* value */
				for (int j = 1; j < ltv_len; j++) {
					sprintf(ch_ptr, "%02x ", *data++);
					ch_ptr += 3;
				}
			}
		}
		sprintf(ch_ptr, "]");
		ch_ptr += 1;
		i += (ltv_len + 1);

		LOG_DBG("%s", ltv_str);
	}
}

static bool message_ltv_found(struct bt_data *data, void *user_data)
{
	struct webusb_ltv_data *_parsed = (struct webusb_ltv_data *)user_data;

	LOG_DBG("Found LTV structure with type %u, len = %u", data->type, data->data_len);

	switch (data->type) {
	case BT_DATA_SID:
		LOG_DBG("BT_DATA_SID");
		_parsed->adv_sid = data->data[0];
		return true;
	case BT_DATA_PA_INTERVAL:
		_parsed->pa_interval = sys_get_le16(data->data);
		LOG_DBG("BT_DATA_PA_INTERVAL");
		return true;
	case BT_DATA_BROADCAST_ID:
		_parsed->broadcast_id = sys_get_le24(data->data);
		LOG_DBG("BT_DATA_BROADCAST_ID");
		return true;
	case BT_DATA_RPA:
	case BT_DATA_IDENTITY:
		char addr_str[BT_ADDR_LE_STR_LEN];
		_parsed->addr.type = data->data[0];
		memcpy(&_parsed->addr.a, &data->data[1], sizeof(bt_addr_t));
		bt_addr_le_to_str(&_parsed->addr, addr_str, sizeof(addr_str));
		LOG_DBG("Addr: %s", addr_str);
		return true;
	case BT_DATA_SOURCE_ID:
		_parsed->src_id = data->data[0];
		LOG_DBG("src_id: %u", _parsed->src_id);
		return true;
	case BT_DATA_BROADCAST_CODE:
		memcpy(&_parsed->broadcast_code, &data->data[0], BT_ISO_BROADCAST_CODE_SIZE);
		LOG_HEXDUMP_DBG(_parsed->broadcast_code, BT_ISO_BROADCAST_CODE_SIZE,
				"broadcast code:");
		return true;
	case BT_DATA_BIS_SYNC:
		_parsed->num_subgroups = data->data_len / sizeof(_parsed->bis_sync[0]);
		memcpy(&_parsed->bis_sync, &data->data[0], data->data_len);
		LOG_HEXDUMP_DBG(_parsed->bis_sync, data->data_len, "bis_sync:");
		return true;
	case BT_DATA_VOLUME:
		_parsed->volume = data->data[0];
		LOG_DBG("volume: %u", _parsed->src_id);
		return true;
	case BT_DATA_SIRK:
		memcpy(&_parsed->csis_sirk, &data->data[0], BT_CSIP_SIRK_SIZE);
		LOG_HEXDUMP_DBG(_parsed->csis_sirk, BT_CSIP_SIRK_SIZE, "sirk:");
		return true;
	case BT_DATA_SET_SIZE:
		_parsed->csis_set_size = data->data[0];
		LOG_DBG("CSIS set size: %u", _parsed->csis_set_size);
		return true;
	case BT_DATA_PA_SYNC_ATTEMPT:
		_parsed->pa_sync_attempt = data->data[0];
		LOG_DBG("PA sync attemp: %u", _parsed->pa_sync_attempt);
		return true;
	default:
		LOG_DBG("Unknown type");
	}

	return false;
}

static void message_prepend_header(struct net_buf *buf, enum message_type mtype,
				   enum message_sub_type stype, uint8_t seq_no, uint16_t len)
{
	net_buf_push_le16(buf, len);
	net_buf_push_u8(buf, seq_no);
	net_buf_push_u8(buf, stype);
	net_buf_push_u8(buf, mtype);
}

struct net_buf* message_alloc_tx(void)
{
	struct net_buf *tx_net_buf;

	tx_net_buf = net_buf_alloc(&command_tx_msg_pool, K_NO_WAIT);
	if (!tx_net_buf) {
		return NULL;
	}

	// Reserve headroom for the webusb msg header
	net_buf_reserve(tx_net_buf, sizeof(struct webusb_message));

	return tx_net_buf;
}

void message_send_no_paylod(enum message_type mtype, enum message_sub_type stype, uint8_t seq_no)
{
	struct net_buf *tx_net_buf;
	int ret;

	tx_net_buf = message_alloc_tx();
	if (!tx_net_buf) {
		LOG_ERR("Failed to allocate net_buf");
	}

	message_prepend_header(tx_net_buf, mtype, stype, seq_no, 0);
	message_log_ltv(&tx_net_buf->data[0], tx_net_buf->len);

	ret = webusb_transmit(tx_net_buf);
	if (ret != 0) {
		LOG_ERR("Failed to send message (err=%d)", ret);
	}
}

void message_send_return_code(enum message_type mtype, enum message_sub_type stype, uint8_t seq_no,
			      int32_t rc)
{
	struct net_buf *tx_net_buf;
	uint16_t msg_payload_length;
	int ret;

	LOG_INF("send simple message(%d, %d, %u, %d)", mtype, stype, seq_no, rc);

	tx_net_buf = message_alloc_tx();
	if (!tx_net_buf) {
		LOG_ERR("Failed to allocate net_buf");
	}

	/* Append error code payload */
	net_buf_add_u8(tx_net_buf, 5);
	net_buf_add_u8(tx_net_buf, BT_DATA_ERROR_CODE);
	net_buf_add_le32(tx_net_buf, rc);
	msg_payload_length = tx_net_buf->len;

	message_prepend_header(tx_net_buf, mtype, stype, seq_no, msg_payload_length);
	message_log_ltv(&tx_net_buf->data[0], tx_net_buf->len);

	ret = webusb_transmit(tx_net_buf);
	if (ret != 0) {
		LOG_ERR("Failed to send message (err=%d)", ret);
	}
}

void message_send_net_buf_event(enum message_sub_type stype, struct net_buf *tx_net_buf)
{
	int ret;

	message_prepend_header(tx_net_buf, MESSAGE_TYPE_EVT, stype, 0, tx_net_buf->len);
	message_log_ltv(&tx_net_buf->data[0], tx_net_buf->len);

	LOG_DBG("send_net_buf_event(stype: %d, len: %zu)", stype, tx_net_buf->len);

	ret = webusb_transmit(tx_net_buf);
	if (ret != 0) {
		LOG_ERR("Failed to send message (err=%d)", ret);
	}
}

void message_handler(struct webusb_message *msg_ptr, uint16_t msg_length)
{
	if (msg_ptr == NULL) {
		LOG_ERR("Null msg_ptr");
		return;
	}

	/*uint8_t msg_type = msg_ptr->type;*/
	uint8_t msg_sub_type = msg_ptr->sub_type;
	uint8_t msg_seq_no = msg_ptr->seq_no;
	int32_t msg_rc = 0;
	struct net_buf_simple msg_net_buf;

	msg_net_buf.data = msg_ptr->payload;
	msg_net_buf.len = msg_ptr->length;
	msg_net_buf.size = CONFIG_TX_MSG_MAX_PAYLOAD_LEN;
	msg_net_buf.__buf = msg_ptr->payload;

	memset(&parsed_ltv_data, 0, sizeof(parsed_ltv_data));
	parsed_ltv_data.pa_sync_attempt = DEFAULT_PA_SYNC_ATTEMPT;
	bt_data_parse(&msg_net_buf, message_ltv_found, (void *)&parsed_ltv_data);

	switch (msg_sub_type) {
	case MESSAGE_SUBTYPE_HEARTBEAT:
		/* Toogle heartbeat mode */
		heartbeat_toggle();
		message_send_return_code(MESSAGE_TYPE_RES, MESSAGE_SUBTYPE_HEARTBEAT, msg_seq_no,
					 0);
		break;

	case MESSAGE_SUBTYPE_START_SINK_SCAN:
		LOG_DBG("START_SINK_SCAN (len %u)", msg_length);
		msg_rc = broadcast_assistant_start_scan(BROADCAST_ASSISTANT_SCAN_SINK,
							0 /* not used*/, 0 /* not used*/,
							0 /* not used*/);
		message_send_return_code(MESSAGE_TYPE_RES, MESSAGE_SUBTYPE_START_SINK_SCAN,
					 msg_seq_no, msg_rc);
		break;

	case MESSAGE_SUBTYPE_START_SOURCE_SCAN:
		LOG_DBG("START_SOURCE_SCAN (len %u)", msg_length);
		msg_rc = broadcast_assistant_start_scan(BROADCAST_ASSISTANT_SCAN_SOURCE,
							0 /* not used*/, 0 /* not used*/,
							parsed_ltv_data.pa_sync_attempt);
		message_send_return_code(MESSAGE_TYPE_RES, MESSAGE_SUBTYPE_START_SOURCE_SCAN,
					 msg_seq_no, msg_rc);
		break;

	case MESSAGE_SUBTYPE_START_ALL_SCAN:
		LOG_DBG("START_ALL_SCAN (len %u)", msg_length);
		/* Currently not supported */
		message_send_return_code(MESSAGE_TYPE_RES, MESSAGE_SUBTYPE_START_ALL_SCAN,
					 msg_seq_no, -1);
		break;

	case MESSAGE_SUBTYPE_START_CSIS_SCAN:
		LOG_DBG("START_CSIS_SCAN (len %u)", msg_length);
		msg_rc = broadcast_assistant_start_scan(BROADCAST_ASSISTANT_SCAN_CSIS,
							parsed_ltv_data.csis_set_size,
							parsed_ltv_data.csis_sirk, 0 /* not used*/);
		message_send_return_code(MESSAGE_TYPE_RES, MESSAGE_SUBTYPE_START_CSIS_SCAN,
					 msg_seq_no, msg_rc);
		break;

	case MESSAGE_SUBTYPE_STOP_SCAN:
		LOG_DBG("STOP_SCAN");
		msg_rc = broadcast_assistant_stop_scanning();
		message_send_return_code(MESSAGE_TYPE_RES, MESSAGE_SUBTYPE_STOP_SCAN, msg_seq_no,
					 msg_rc);
		break;

	case MESSAGE_SUBTYPE_CONNECT_SINK:
		LOG_DBG("CONNECT_SINK (len %u)", msg_length);
		msg_rc = broadcast_assistant_connect_to_sink(&parsed_ltv_data.addr);
		message_send_return_code(MESSAGE_TYPE_RES, MESSAGE_SUBTYPE_CONNECT_SINK, msg_seq_no,
					 msg_rc);
		break;

	case MESSAGE_SUBTYPE_DISCONNECT_SINK:
		LOG_DBG("DISCONNECT_SINK (len %u)", msg_length);
		msg_rc = broadcast_assistant_disconnect_from_sink(&parsed_ltv_data.addr);
		message_send_return_code(MESSAGE_TYPE_RES, MESSAGE_SUBTYPE_DISCONNECT_SINK,
					 msg_seq_no, msg_rc);
		break;

	case MESSAGE_SUBTYPE_ADD_SOURCE:
		LOG_DBG("ADD_SOURCE (len %u)", msg_length);
		msg_rc = broadcast_assistant_add_source(
			parsed_ltv_data.adv_sid, parsed_ltv_data.pa_interval,
			parsed_ltv_data.broadcast_id, &parsed_ltv_data.addr,
			parsed_ltv_data.num_subgroups, parsed_ltv_data.bis_sync);
		message_send_return_code(MESSAGE_TYPE_RES, MESSAGE_SUBTYPE_ADD_SOURCE, msg_seq_no,
					 msg_rc);
		break;

	case MESSAGE_SUBTYPE_PA_SYNC:
		LOG_DBG("PA_SYNC (len %u)", msg_length);
		msg_rc = broadcast_assistant_pa_sync(&parsed_ltv_data.addr, parsed_ltv_data.adv_sid,
						     parsed_ltv_data.pa_interval);
		message_send_return_code(MESSAGE_TYPE_RES, MESSAGE_SUBTYPE_PA_SYNC, msg_seq_no,
					 msg_rc);
		break;

	case MESSAGE_SUBTYPE_REMOVE_SOURCE:
		LOG_DBG("REMOVE_SOURCE (len %u)", msg_length);
		msg_rc = broadcast_assistant_remove_source(parsed_ltv_data.src_id,
							   parsed_ltv_data.num_subgroups);
		message_send_return_code(MESSAGE_TYPE_RES, MESSAGE_SUBTYPE_REMOVE_SOURCE,
					 msg_seq_no, msg_rc);
		break;

	case MESSAGE_SUBTYPE_BIG_BCODE:
		LOG_DBG("BIG_BCODE (len %u)", msg_length);
		msg_rc = broadcast_assistant_add_broadcast_code(parsed_ltv_data.src_id,
								parsed_ltv_data.broadcast_code);
		message_send_return_code(MESSAGE_TYPE_RES, MESSAGE_SUBTYPE_BIG_BCODE, msg_seq_no,
					 msg_rc);
		break;

	case MESSAGE_SUBTYPE_SET_VOLUME:
		LOG_DBG("SET_VOLUME (vol %u, len %u)", parsed_ltv_data.volume, msg_length);
		msg_rc = broadcast_assistant_set_volume(&parsed_ltv_data.addr,
							parsed_ltv_data.volume);
		message_send_return_code(MESSAGE_TYPE_RES, MESSAGE_SUBTYPE_SET_VOLUME, msg_seq_no,
					 msg_rc);
		break;

	case MESSAGE_SUBTYPE_MUTE:
		LOG_DBG("MUTE (len %u)", msg_length);
		msg_rc = broadcast_assistant_set_mute(&parsed_ltv_data.addr, BT_VCP_STATE_MUTED);
		message_send_return_code(MESSAGE_TYPE_RES, MESSAGE_SUBTYPE_MUTE, msg_seq_no,
					 msg_rc);
		break;

	case MESSAGE_SUBTYPE_UNMUTE:
		LOG_DBG("UNMUTE (len %u)", msg_length);
		msg_rc = broadcast_assistant_set_mute(&parsed_ltv_data.addr, BT_VCP_STATE_UNMUTED);
		message_send_return_code(MESSAGE_TYPE_RES, MESSAGE_SUBTYPE_UNMUTE, msg_seq_no,
					 msg_rc);
		break;

	case MESSAGE_SUBTYPE_RESET:
		LOG_DBG("RESET (len %u)", msg_length);
		msg_rc = broadcast_assistant_reset();
		message_send_return_code(MESSAGE_TYPE_RES, MESSAGE_SUBTYPE_RESET, msg_seq_no,
					 msg_rc);
		heartbeat_stop(); // Stop heartbeat if active
		break;

	default:
		// Unrecognized message
		message_send_return_code(MESSAGE_TYPE_RES, msg_sub_type, msg_seq_no, -1);
		break;
	}
}
```

## src/message.h
```c
/*
 * Copyright (c) 2024 Demant A/S
 *
 * SPDX-License-Identifier: Apache-2.0
 */

#ifndef __MESSAGE_H__
#define __MESSAGE_H__

#include <zephyr/types.h>

enum message_type {
	MESSAGE_TYPE_CMD = 1,
	MESSAGE_TYPE_RES,
	MESSAGE_TYPE_EVT,
};

enum message_sub_type {
	/* CMD/RES (bit7 = 0) */
	MESSAGE_SUBTYPE_START_SINK_SCAN         = 0x01,
	MESSAGE_SUBTYPE_START_SOURCE_SCAN       = 0x02,
	MESSAGE_SUBTYPE_START_ALL_SCAN          = 0x03,
	MESSAGE_SUBTYPE_STOP_SCAN               = 0x04,
	MESSAGE_SUBTYPE_CONNECT_SINK            = 0x05,
	MESSAGE_SUBTYPE_DISCONNECT_SINK         = 0x06,
	MESSAGE_SUBTYPE_ADD_SOURCE              = 0x07,
	MESSAGE_SUBTYPE_REMOVE_SOURCE           = 0x08,
	MESSAGE_SUBTYPE_BIG_BCODE               = 0x09,
	MESSAGE_SUBTYPE_SET_VOLUME              = 0x0A,
	MESSAGE_SUBTYPE_MUTE                    = 0x0B,
	MESSAGE_SUBTYPE_UNMUTE                  = 0x0C,
	MESSAGE_SUBTYPE_START_CSIS_SCAN         = 0x0D,
	MESSAGE_SUBTYPE_PA_SYNC                 = 0x0E,

	MESSAGE_SUBTYPE_RESET                   = 0x2A,

	/* EVT (bit7 = 1) */
	MESSAGE_SUBTYPE_SINK_FOUND              = 0x81,
	MESSAGE_SUBTYPE_SOURCE_FOUND            = 0x82,
	MESSAGE_SUBTYPE_SINK_CONNECTED          = 0x83,
	MESSAGE_SUBTYPE_SINK_DISCONNECTED       = 0x84,
	MESSAGE_SUBTYPE_SOURCE_ADDED            = 0x85,
	MESSAGE_SUBTYPE_SOURCE_REMOVED          = 0x86,
	MESSAGE_SUBTYPE_NEW_PA_STATE_NOT_SYNCED = 0x87,
	MESSAGE_SUBTYPE_NEW_PA_STATE_INFO_REQ   = 0x88,
	MESSAGE_SUBTYPE_NEW_PA_STATE_SYNCED     = 0x89,
	MESSAGE_SUBTYPE_NEW_PA_STATE_FAILED     = 0x8A,
	MESSAGE_SUBTYPE_NEW_PA_STATE_NO_PAST    = 0x8B,
	MESSAGE_SUBTYPE_BIS_SYNCED              = 0x8C,
	MESSAGE_SUBTYPE_BIS_NOT_SYNCED          = 0x8D,
	MESSAGE_SUBTYPE_IDENTITY_RESOLVED	= 0x8E,
	MESSAGE_SUBTYPE_SOURCE_BASE_FOUND       = 0x8F,
	MESSAGE_SUBTYPE_SOURCE_BIG_INFO         = 0x90,
	MESSAGE_SUBTYPE_NEW_ENC_STATE_NO_ENC    = 0x91,
	MESSAGE_SUBTYPE_NEW_ENC_STATE_BCODE_REQ = 0x92,
	MESSAGE_SUBTYPE_NEW_ENC_STATE_DEC       = 0x93,
	MESSAGE_SUBTYPE_NEW_ENC_STATE_BAD_CODE  = 0x94,
	MESSAGE_SUBTYPE_VOLUME_STATE            = 0x95,
	MESSAGE_SUBTYPE_VOLUME_CONTROL_FOUND    = 0x96,
	MESSAGE_SUBTYPE_SET_IDENTIFIER_FOUND    = 0x97,
	MESSAGE_SUBTYPE_SET_MEMBER_FOUND        = 0x98,

	MESSAGE_SUBTYPE_HEARTBEAT               = 0xFF,
};

struct webusb_message {
	uint8_t type;
	uint8_t sub_type;
	uint8_t seq_no;
	uint16_t length;
	uint8_t payload[];
} __packed;

struct net_buf* message_alloc_tx(void);
void message_send_no_paylod(enum message_type mtype, enum message_sub_type stype, uint8_t seq_no);
void message_send_return_code(enum message_type mtype, enum message_sub_type stype, uint8_t seq_no,
			      int32_t rc);
void message_send_net_buf_event(enum message_sub_type stype, struct net_buf *tx_net_buf);
void message_handler(struct webusb_message *msg_ptr, uint16_t msg_length);

#endif /* __MESSAGE_H__ */
```

## src/message_handler.c
```c
/*
 * Copyright (c) 2024 Demant A/S
 *
 * SPDX-License-Identifier: Apache-2.0
 */

#include <zephyr/types.h>
#include <zephyr/logging/log.h>
#include <zephyr/kernel.h>
#include <zephyr/sys/byteorder.h>
#include <zephyr/net/buf.h>
#include <zephyr/bluetooth/bluetooth.h>
#include <zephyr/bluetooth/audio/bap.h>
#include <zephyr/bluetooth/audio/vcp.h>

#include "webusb.h"
#include "broadcast_assistant.h"
#include "message_handler.h"

LOG_MODULE_REGISTER(message_handler, LOG_LEVEL_INF);

NET_BUF_POOL_DEFINE(command_tx_msg_pool, CONFIG_TX_MSG_MAX_MESSAGES, sizeof(struct webusb_message) + CONFIG_TX_MSG_MAX_PAYLOAD_LEN, 0, NULL);

struct webusb_ltv_data {
	uint8_t adv_sid;
	uint16_t pa_interval;
	uint32_t broadcast_id;
	bt_addr_le_t addr;
	uint8_t src_id;
	uint8_t volume;
	uint8_t broadcast_code[BT_AUDIO_BROADCAST_CODE_SIZE];
	uint8_t num_subgroups;
	uint32_t bis_sync[CONFIG_BT_BAP_BASS_MAX_SUBGROUPS];
	uint8_t csis_set_size;
	uint8_t csis_sirk[BT_CSIP_SIRK_SIZE];
};

static struct webusb_ltv_data parsed_ltv_data;

static void heartbeat_timeout_handler(struct k_timer *dummy_p);
K_TIMER_DEFINE(heartbeat_timer, heartbeat_timeout_handler, NULL);

static void log_ltv(uint8_t *data, uint16_t data_len);

#define LTV_STR_LEN 1024

static void log_ltv(uint8_t *data, uint16_t data_len)
{
	char ltv_str[LTV_STR_LEN] = {0};

	/* Log message payload (ltv format) */
	for (int i = 0; i < data_len;) {
		uint8_t ltv_len = *data++;
		char *ch_ptr = &ltv_str[0];

		/* length */
		sprintf(ch_ptr, "[ L:%02x ", ltv_len);
		ch_ptr += 7;
		if (ltv_len > 0) {
			/* type */
			sprintf(ch_ptr, "T:%02x ", *data++);
			ch_ptr += 5;
			if (ltv_len > 1) {
				/* value */
				for (int j = 1; j < ltv_len; j++) {
					sprintf(ch_ptr, "%02x ", *data++);
					ch_ptr += 3;
				}
			}
		}
		sprintf(ch_ptr, "]");
		ch_ptr += 1;
		i += (ltv_len + 1);

		LOG_DBG("%s", ltv_str);
	}
}

static void heartbeat_timeout_handler(struct k_timer *timer)
{
	static uint8_t heartbeat_cnt = 0;
	struct net_buf *tx_net_buf;
	int ret;

	tx_net_buf = net_buf_alloc(&command_tx_msg_pool, K_FOREVER);
	if (!tx_net_buf) {
		return;
	}

	net_buf_push_le16(tx_net_buf, 0);
	net_buf_push_u8(tx_net_buf, heartbeat_cnt++);
	net_buf_push_u8(tx_net_buf, MESSAGE_SUBTYPE_HEARTBEAT);
	net_buf_push_u8(tx_net_buf, MESSAGE_TYPE_EVT);

	ret = webusb_transmit(tx_net_buf);
	if (ret != 0) {
		LOG_ERR("Failed to send response (err=%d)", ret);
	}
}

struct net_buf* message_alloc_tx_message(void)
{
	struct net_buf *tx_net_buf;

	tx_net_buf = net_buf_alloc(&command_tx_msg_pool, K_NO_WAIT);
	if (!tx_net_buf) {
		return NULL;
	}

	// Reserve headroom for the webusb msg header
	net_buf_reserve(tx_net_buf, sizeof(struct webusb_message));

	return tx_net_buf;
}

static void send_simple_message(enum message_type mtype, enum message_sub_type stype, uint8_t seq_no, int32_t rc)
{
	struct net_buf *tx_net_buf;
	uint16_t msg_payload_length;
	int ret;

	LOG_INF("send simple message(%d, %d, %u, %d)", mtype, stype, seq_no, rc);


	tx_net_buf = message_alloc_tx_message();
	if (!tx_net_buf) {
		LOG_ERR("Failed to allocate net_buf");
	}

	/* Append error code payload */
	net_buf_add_u8(tx_net_buf, 5);
	net_buf_add_u8(tx_net_buf, BT_DATA_ERROR_CODE);
	net_buf_add_le32(tx_net_buf, rc);
	msg_payload_length = tx_net_buf->len;

	// Prepend message header
	net_buf_push_le16(tx_net_buf, msg_payload_length);
	net_buf_push_u8(tx_net_buf, seq_no);
	net_buf_push_u8(tx_net_buf, stype);
	net_buf_push_u8(tx_net_buf, mtype);

	log_ltv(&tx_net_buf->data[0], tx_net_buf->len);

	ret = webusb_transmit(tx_net_buf);
	if (ret != 0) {
		LOG_ERR("Failed to send message (err=%d)", ret);
	}

}

void send_response(enum message_sub_type stype, uint8_t seq_no, int32_t rc)
{
	send_simple_message(MESSAGE_TYPE_RES, stype, seq_no, rc);
}

void send_event(enum message_sub_type stype, int32_t rc)
{
	send_simple_message(MESSAGE_TYPE_EVT, stype, 0, rc);
}

void send_net_buf_event(enum message_sub_type stype, struct net_buf *tx_net_buf)
{
	int ret;

	// Prepend message header
	net_buf_push_le16(tx_net_buf, tx_net_buf->len);
	net_buf_push_u8(tx_net_buf, 0);
	net_buf_push_u8(tx_net_buf, stype);
	net_buf_push_u8(tx_net_buf, MESSAGE_TYPE_EVT);

	LOG_DBG("send_net_buf_event(stype: %d, len: %zu)", stype, tx_net_buf->len);
	log_ltv(&tx_net_buf->data[0], tx_net_buf->len);

	ret = webusb_transmit(tx_net_buf);
	if (ret != 0) {
		LOG_ERR("Failed to send message (err=%d)", ret);
	}
}

bool ltv_found(struct bt_data *data, void *user_data)
{
	struct webusb_ltv_data *_parsed = (struct webusb_ltv_data *)user_data;

	LOG_DBG("Found LTV structure with type %u, len = %u", data->type, data->data_len);

	switch (data->type) {
	case BT_DATA_SID:
		LOG_DBG("BT_DATA_SID");
		_parsed->adv_sid = data->data[0];
		return true;
	case BT_DATA_PA_INTERVAL:
		_parsed->pa_interval = sys_get_le16(data->data);
		LOG_DBG("BT_DATA_PA_INTERVAL");
		return true;
	case BT_DATA_BROADCAST_ID:
		_parsed->broadcast_id = sys_get_le24(data->data);
		LOG_DBG("BT_DATA_BROADCAST_ID");
		return true;
	case BT_DATA_RPA:
	case BT_DATA_IDENTITY:
		char addr_str[BT_ADDR_LE_STR_LEN];
		_parsed->addr.type = data->data[0];
		memcpy(&_parsed->addr.a, &data->data[1], sizeof(bt_addr_t));
		bt_addr_le_to_str(&_parsed->addr, addr_str, sizeof(addr_str));
		LOG_DBG("Addr: %s", addr_str);
		return true;
	case BT_DATA_SOURCE_ID:
		_parsed->src_id = data->data[0];
		LOG_DBG("src_id: %u", _parsed->src_id);
		return true;
	case BT_DATA_BROADCAST_CODE:
		memcpy(&_parsed->broadcast_code, &data->data[0], BT_AUDIO_BROADCAST_CODE_SIZE);
		LOG_HEXDUMP_DBG(_parsed->broadcast_code, BT_AUDIO_BROADCAST_CODE_SIZE, "broadcast code:");
		return true;
	case BT_DATA_BIS_SYNC:
		_parsed->num_subgroups = data->data_len / sizeof(_parsed->bis_sync[0]);
		memcpy(&_parsed->bis_sync, &data->data[0], data->data_len);
		LOG_HEXDUMP_DBG(_parsed->bis_sync, data->data_len, "bis_sync:");
		return true;
	case BT_DATA_VOLUME:
		_parsed->volume = data->data[0];
		LOG_DBG("volume: %u", _parsed->src_id);
		return true;
	case BT_DATA_SIRK:
		memcpy(&_parsed->csis_sirk, &data->data[0], BT_CSIP_SIRK_SIZE);
		LOG_HEXDUMP_DBG(_parsed->csis_sirk, BT_CSIP_SIRK_SIZE, "sirk:");
		return true;
	case BT_DATA_SET_SIZE:
		_parsed->csis_set_size = data->data[0];
		LOG_DBG("CSIS set size: %u", _parsed->csis_set_size);
		return true;
	default:
		LOG_DBG("Unknown type");
	}

	return false;
}

void message_handler(struct webusb_message *msg_ptr, uint16_t msg_length)
{
	if (msg_ptr == NULL) {
		LOG_ERR("Null msg_ptr");
		return;
	}

	/*uint8_t msg_type = msg_ptr->type;*/
	uint8_t msg_sub_type = msg_ptr->sub_type;
	uint8_t msg_seq_no = msg_ptr->seq_no;
	int32_t msg_rc = 0;
	struct net_buf_simple msg_net_buf;

	msg_net_buf.data = msg_ptr->payload;
	msg_net_buf.len = msg_ptr->length;
	msg_net_buf.size = CONFIG_TX_MSG_MAX_PAYLOAD_LEN;
	msg_net_buf.__buf = msg_ptr->payload;

	memset(&parsed_ltv_data, 0, sizeof(parsed_ltv_data));
	bt_data_parse(&msg_net_buf, ltv_found, (void *)&parsed_ltv_data);

	switch (msg_sub_type) {
	case MESSAGE_SUBTYPE_HEARTBEAT:
			static bool heartbeat_on = false;
			if (!heartbeat_on) {
			// Start generating heartbeats every second
				heartbeat_on = true;
			k_timer_start(&heartbeat_timer, K_SECONDS(1), K_SECONDS(1));
		} else {
				heartbeat_on = false;
			// Stop heartbeat timer if running
			k_timer_stop(&heartbeat_timer);
		}
		send_response(MESSAGE_SUBTYPE_HEARTBEAT, msg_seq_no, 0);
		break;

	case MESSAGE_SUBTYPE_START_SINK_SCAN:
		LOG_DBG("MESSAGE_SUBTYPE_START_SINK_SCAN");
		msg_rc = start_scan(BROADCAST_ASSISTANT_SCAN_SINK, parsed_ltv_data.csis_set_size,
				    parsed_ltv_data.csis_sirk);
		send_response(MESSAGE_SUBTYPE_START_SINK_SCAN, msg_seq_no, msg_rc);
		break;

	case MESSAGE_SUBTYPE_START_SOURCE_SCAN:
		LOG_DBG("MESSAGE_SUBTYPE_START_SOURCE_SCAN");
		msg_rc = start_scan(BROADCAST_ASSISTANT_SCAN_SOURCE, parsed_ltv_data.csis_set_size,
				    parsed_ltv_data.csis_sirk);
		send_response(MESSAGE_SUBTYPE_START_SOURCE_SCAN, msg_seq_no, msg_rc);
		break;

	case MESSAGE_SUBTYPE_START_CSIS_SCAN:
		LOG_DBG("MESSAGE_SUBTYPE_START_CSIS_SCAN (len %u)", msg_length);
		msg_rc = start_scan(BROADCAST_ASSISTANT_SCAN_CSIS, parsed_ltv_data.csis_set_size,
				    parsed_ltv_data.csis_sirk);
		send_response(MESSAGE_SUBTYPE_START_CSIS_SCAN, msg_seq_no, msg_rc);
		break;

	case MESSAGE_SUBTYPE_STOP_SCAN:
		LOG_DBG("MESSAGE_SUBTYPE_STOP_SCAN");
		msg_rc = stop_scanning();
		send_response(MESSAGE_SUBTYPE_STOP_SCAN, msg_seq_no, msg_rc);
		break;

	case MESSAGE_SUBTYPE_CONNECT_SINK:
		LOG_DBG("MESSAGE_SUBTYPE_CONNECT_SINK (len %u)", msg_length);
		msg_rc = connect_to_sink(&parsed_ltv_data.addr);
		send_response(MESSAGE_SUBTYPE_CONNECT_SINK, msg_seq_no, msg_rc);
		break;

	case MESSAGE_SUBTYPE_DISCONNECT_SINK:
		LOG_DBG("MESSAGE_SUBTYPE_DISCONNECT_SINK (len %u)", msg_length);
		msg_rc = disconnect_from_sink(&parsed_ltv_data.addr);
		send_response(MESSAGE_SUBTYPE_DISCONNECT_SINK, msg_seq_no, msg_rc);
		break;

	case MESSAGE_SUBTYPE_ADD_SOURCE:
		LOG_DBG("MESSAGE_SUBTYPE_ADD_SOURCE (len %u)", msg_length);
#if 0 /* TODO: Test. Remove later */
		parsed_ltv_data.num_subgroups = 5;
		parsed_ltv_data.bis_sync[0] = 0x0;
		parsed_ltv_data.bis_sync[1] = 0x2;
		parsed_ltv_data.bis_sync[2] = 0x0;
		parsed_ltv_data.bis_sync[3] = 0x0;
		parsed_ltv_data.bis_sync[4] = 0x0;
#endif
		msg_rc = add_source(parsed_ltv_data.adv_sid, parsed_ltv_data.pa_interval,
				    parsed_ltv_data.broadcast_id, &parsed_ltv_data.addr,
				    parsed_ltv_data.num_subgroups, parsed_ltv_data.bis_sync);
		send_response(MESSAGE_SUBTYPE_ADD_SOURCE, msg_seq_no, msg_rc);
		break;

	case MESSAGE_SUBTYPE_REMOVE_SOURCE:
		LOG_DBG("MESSAGE_SUBTYPE_REMOVE_SOURCE (len %u)", msg_length);
		msg_rc = remove_source(parsed_ltv_data.src_id, parsed_ltv_data.num_subgroups);
		send_response(MESSAGE_SUBTYPE_REMOVE_SOURCE, msg_seq_no, msg_rc);
		break;

	case MESSAGE_SUBTYPE_BIG_BCODE:
		LOG_DBG("MESSAGE_SUBTYPE_BIG_BCODE (len %u)", msg_length);
		msg_rc = add_broadcast_code(parsed_ltv_data.src_id, parsed_ltv_data.broadcast_code);
		send_response(MESSAGE_SUBTYPE_BIG_BCODE, msg_seq_no, msg_rc);
		break;

	case MESSAGE_SUBTYPE_SET_VOLUME:
		LOG_DBG("MESSAGE_SUBTYPE_SET_VOLUME (vol %u, len %u)", parsed_ltv_data.volume, msg_length);
		msg_rc = set_volume(&parsed_ltv_data.addr, parsed_ltv_data.volume);
		send_response(MESSAGE_SUBTYPE_SET_VOLUME, msg_seq_no, msg_rc);
		break;

	case MESSAGE_SUBTYPE_MUTE:
		LOG_DBG("MESSAGE_SUBTYPE_MUTE (len %u)", msg_length);
		msg_rc = set_mute(&parsed_ltv_data.addr, BT_VCP_STATE_MUTED);
		send_response(MESSAGE_SUBTYPE_MUTE, msg_seq_no, msg_rc);
		break;

	case MESSAGE_SUBTYPE_UNMUTE:
		LOG_DBG("MESSAGE_SUBTYPE_UNMUTE (len %u)", msg_length);
		msg_rc = set_mute(&parsed_ltv_data.addr, BT_VCP_STATE_UNMUTED);
		send_response(MESSAGE_SUBTYPE_UNMUTE, msg_seq_no, msg_rc);
		break;

	case MESSAGE_SUBTYPE_RESET:
		LOG_DBG("MESSAGE_SUBTYPE_RESET (len %u)", msg_length);
		msg_rc = stop_scanning();
		send_response(MESSAGE_SUBTYPE_STOP_SCAN, msg_seq_no, msg_rc);
		msg_rc = disconnect_unpair_all();
		send_response(MESSAGE_SUBTYPE_RESET, msg_seq_no, msg_rc);
		// Stop heartbeat if active
		heartbeat_on = false;
		k_timer_stop(&heartbeat_timer);
		break;

	default:
		// Unrecognized message
		send_response(msg_sub_type, msg_seq_no, -1);
		break;
	}
}

void message_handler_init(void)
{
	k_timer_init(&heartbeat_timer, heartbeat_timeout_handler, NULL);
}
```

## src/message_handler.h
```c
/*
 * Copyright (c) 2024 Demant A/S
 *
 * SPDX-License-Identifier: Apache-2.0
 */

#ifndef __COMMAND_H__
#define __COMMAND_H__

#include <zephyr/types.h>

enum message_type {
	MESSAGE_TYPE_CMD = 1,
	MESSAGE_TYPE_RES,
	MESSAGE_TYPE_EVT,
};

enum message_sub_type {
	/* CMD/RES (bit7 = 0) */
	MESSAGE_SUBTYPE_START_SINK_SCAN         = 0x01,
	MESSAGE_SUBTYPE_START_SOURCE_SCAN       = 0x02,
	MESSAGE_SUBTYPE_START_CSIS_SCAN         = 0x03,
	MESSAGE_SUBTYPE_STOP_SCAN               = 0x04,
	MESSAGE_SUBTYPE_CONNECT_SINK            = 0x05,
	MESSAGE_SUBTYPE_DISCONNECT_SINK         = 0x06,
	MESSAGE_SUBTYPE_ADD_SOURCE              = 0x07,
	MESSAGE_SUBTYPE_REMOVE_SOURCE           = 0x08,
	MESSAGE_SUBTYPE_BIG_BCODE               = 0x09,
	MESSAGE_SUBTYPE_SET_VOLUME              = 0x0A,
	MESSAGE_SUBTYPE_MUTE                    = 0x0B,
	MESSAGE_SUBTYPE_UNMUTE                  = 0x0C,

	MESSAGE_SUBTYPE_RESET                   = 0x2A,

	/* EVT (bit7 = 1) */
	MESSAGE_SUBTYPE_SINK_FOUND              = 0x81,
	MESSAGE_SUBTYPE_SOURCE_FOUND            = 0x82,
	MESSAGE_SUBTYPE_SINK_CONNECTED          = 0x83,
	MESSAGE_SUBTYPE_SINK_DISCONNECTED       = 0x84,
	MESSAGE_SUBTYPE_SOURCE_ADDED            = 0x85,
	MESSAGE_SUBTYPE_SOURCE_REMOVED          = 0x86,
	MESSAGE_SUBTYPE_NEW_PA_STATE_NOT_SYNCED = 0x87,
	MESSAGE_SUBTYPE_NEW_PA_STATE_INFO_REQ   = 0x88,
	MESSAGE_SUBTYPE_NEW_PA_STATE_SYNCED     = 0x89,
	MESSAGE_SUBTYPE_NEW_PA_STATE_FAILED     = 0x8A,
	MESSAGE_SUBTYPE_NEW_PA_STATE_NO_PAST    = 0x8B,
	MESSAGE_SUBTYPE_BIS_SYNCED              = 0x8C,
	MESSAGE_SUBTYPE_BIS_NOT_SYNCED          = 0x8D,
	MESSAGE_SUBTYPE_IDENTITY_RESOLVED	= 0x8E,
	MESSAGE_SUBTYPE_SOURCE_BASE_FOUND       = 0x8F,
	MESSAGE_SUBTYPE_SOURCE_BIG_INFO         = 0x90,
	MESSAGE_SUBTYPE_NEW_ENC_STATE_NO_ENC    = 0x91,
	MESSAGE_SUBTYPE_NEW_ENC_STATE_BCODE_REQ = 0x92,
	MESSAGE_SUBTYPE_NEW_ENC_STATE_DEC       = 0x93,
	MESSAGE_SUBTYPE_NEW_ENC_STATE_BAD_CODE  = 0x94,
	MESSAGE_SUBTYPE_VOLUME_STATE            = 0x95,
	MESSAGE_SUBTYPE_VOLUME_CONTROL_FOUND    = 0x96,
	MESSAGE_SUBTYPE_SET_IDENTIFIER_FOUND    = 0x97,
	MESSAGE_SUBTYPE_SET_MEMBER_FOUND        = 0x98,

	MESSAGE_SUBTYPE_HEARTBEAT               = 0xFF,
};

struct webusb_message {
	uint8_t type;
	uint8_t sub_type;
	uint8_t seq_no;
	uint16_t length;
	uint8_t payload[];
} __packed;

struct net_buf* message_alloc_tx_message(void);
void send_response(enum message_sub_type stype, uint8_t seq_no, int32_t rc);
void send_event(enum message_sub_type stype, int32_t rc);
void send_net_buf_event(enum message_sub_type stype, struct net_buf *tx_net_buf);
void message_handler(struct webusb_message *msg_ptr, uint16_t msg_length);
void message_handler_init(void);

#endif /* __COMMAND_H__ */
```

## src/msosv2.h
```c
/*
 * Copyright (c) 2024 Demant A/S
 *
 * SPDX-License-Identifier: Apache-2.0
 */

#include <zephyr/sys/byteorder.h>
#include <zephyr/usb/usb_device.h>
#include <zephyr/usb/bos.h>
#include <zephyr/usb/msos_desc.h>

#include "webusb.h"


int msosv2_custom_handle_req(struct usb_setup_packet *pSetup, int32_t *len, uint8_t **data);

int msosv2_vendor_handle_req(struct usb_setup_packet *pSetup, int32_t *len, uint8_t **data);

void msosv2_init(void);
```
