## west.yml
```yaml
manifest:
  remotes:
    - name: zephyrproject-rtos
      url-base: https://github.com/zephyrproject-rtos

  projects:
    - name: zephyr
      remote: zephyrproject-rtos
      revision: 8469084dfae85f854555f0607f2c838dad097235
      import:
        name-allowlist:
          - cmsis
          - hal_nordic
          - tinycrypt
          - libmetal
          - open-amp
```
